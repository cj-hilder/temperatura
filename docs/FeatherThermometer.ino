/* ============================================================================
 * FeatherThermometer.ino
 *
 * Battery-powered BLE thermometer. Advertises live readings as a beacon, and
 * accepts a GATT connection for reliable in-order delivery. The client picks
 * whichever it wants.
 *
 * PARTS
 *   Adafruit 5323  ESP32-S3 Feather, 8MB flash / no PSRAM, STEMMA QT
 *                  (MAX17048 fuel gauge on board, I2C 0x36, post-Feb-2023 rev)
 *   Adafruit 4650  128x64 monochrome OLED FeatherWing, SH1107, I2C 0x3C
 *   Adafruit 642   High-temp waterproof DS18B20 1-Wire probe (+4.7k resistor)
 *   Adafruit 481   16mm rugged metal momentary pushbutton w/ blue LED ring
 *   Adafruit 258   3.7V 1200mAh LiPo, JST-PH
 *
 * BEHAVIOUR
 *   - While on, a long press (>=1200 ms) turns the unit off. "Off" is ESP32
 *     deep sleep; the button is the EXT0 wake source.
 *   - While off, a long press of the same duration turns it on. Symmetric
 *     hold at both ends, for the same reason bike lights do it: a knock in a
 *     bag must not switch the unit on. A brief press wakes the chip, fails
 *     the hold check and puts it straight back to sleep, having initialised
 *     nothing. The press that starts it is then swallowed, so it counts as
 *     neither a short press nor the start of a long press.
 *   - Power-on and power-off are immediate; there is no splash screen. The
 *     digit area stays blank until the first conversion lands (~750 ms); the
 *     battery icon is what tells you the unit is on.
 *   - Battery state is a permanent icon in the top right corner rather than
 *     a screen of its own, and a Bluetooth icon appears beside it while a
 *     central is connected.
 *   - While on, the temperature is redrawn every time the DS18B20 delivers a
 *     new conversion (~1.3 Hz at 12-bit resolution).
 *   - Every sample carries a monotonic sequence number.
 *   - Not connected: a connectable advertisement carries the latest sample in
 *     manufacturer data, so a passive scanner gets live values.
 *   - Connected: the same sample goes out as a notification. The BLE Link
 *     Layer acknowledges and retransmits, and ATT preserves ordering, so
 *     nothing is lost or reordered for as long as the link is up.
 *   - A short press does not change power state; it increments a press
 *     counter carried in both the beacon and the notification.
 *
 *   Nothing is buffered. Samples taken while no central is connected are not
 *   retained, by design - the client is expected to connect when it wants a
 *   continuous record and to accept gaps when it does not.
 *
 * ---------------------------------------------------------------------------
 * WIRING
 * ---------------------------------------------------------------------------
 *
 * OLED FeatherWing (4650)
 *   Stacks straight onto the Feather headers - no discrete wiring. For
 *   reference, the wing uses:
 *       3V, GND
 *       SDA  = GPIO3    (5k pull-up on the Feather, fed from the I2C power pin)
 *       SCL  = GPIO4    (5k pull-up on the Feather)
 *       RST  = Feather RST (the wing's reset button)
 *       A/B/C buttons = GPIO9 / GPIO6 / GPIO5   <-- NOT used by this sketch,
 *                                                   but keep those pins free.
 *
 * DS18B20 probe (642)
 *   The probe ships in one of two colour schemes - check yours before wiring:
 *       Scheme 1:  Red          -> 3V
 *                  Black        -> GND
 *                  White        -> DATA
 *       Scheme 2:  Orange strip -> 3V
 *                  White        -> GND
 *                  Blue strip   -> DATA
 *   DATA -> A1 (GPIO17)
 *   4.7k resistor from A1 (GPIO17) to 3V.  This pull-up is mandatory; the
 *   bus does not work without it. Parasite power is not used.
 *
 * Pushbutton (481) - switch section (3 spade terminals)
 *   C  (common)          -> GND
 *   NO (normally open)   -> A0 (GPIO18)
 *   NC                   -> not connected
 *   The internal pull-up on GPIO18 is enabled in software, so pressed = LOW.
 *   GPIO18 is an RTC GPIO, which is what makes EXT0 deep-sleep wake possible.
 *
 * Pushbutton (481) - LED ring (2 spade terminals), OPTIONAL
 *   The ring is rated 3-6 V and has its own series resistor. It is too much
 *   load for a GPIO, and at 3.3 V it is dim, so drive it low-side off the
 *   battery rail:
 *       LED+            -> BAT   (3.7-4.2 V from the LiPo)
 *       LED-            -> collector of an NPN (2N3904 / BC337 / MMBT3904)
 *       NPN emitter     -> GND
 *       NPN base        -> 1k -> A2 (GPIO16)
 *   Set USE_BUTTON_LED to 0 below if you are not fitting the transistor.
 *
 * Battery (258)
 *   Plug into the Feather's JST-PH connector. The MAX17048 needs the battery
 *   present to report a meaningful percentage - on USB-only the reading is
 *   not trustworthy.
 *
 * ===========================================================================
 * BLE INTERFACE
 * ===========================================================================
 *
 * All multi-byte fields are LITTLE ENDIAN.
 *
 * Temperature encoding, used everywhere:
 *   int16, units of 0.01 degC.  21.5 degC -> 2150.  -3.2 degC -> -320.
 *   0x8000 (-32768) means "no valid reading".
 *
 * ---------------------------------------------------------------------------
 * Advertisement (connectable, undirected; stops while a central is connected)
 * ---------------------------------------------------------------------------
 *   Flags, short local name, 16-bit service UUID 0x181A, and AD type 0xFF
 *   Manufacturer Specific Data, 8 bytes:
 *
 *     [0..1]  Company Identifier. 0xFFFF is the SIG value reserved for
 *             internal/test use - replace it with your own assigned ID.
 *     [2..3]  Sequence number, uint16.
 *     [4..5]  Temperature, int16.
 *     [6]     Battery percentage, uint8, 0..100.
 *     [7]     Press count, uint8, wraps at 256.
 *
 *   The sequence number matters most in the beacon, where there is no
 *   delivery guarantee: without it a receiver cannot tell a fresh sample that
 *   happens to read the same as the last one from a repeat of the same
 *   advertisement. Compare against the previous value to deduplicate and to
 *   count how many samples were missed. Same for the press count: the
 *   difference since the last observation is the number of presses, which
 *   survives an arbitrarily long scan gap and copes with two quick presses.
 *   Over a connection both are simply confirmation that nothing was dropped.
 *
 *   Sequence numbers persist across deep sleep, so switching the unit off and
 *   on does not reset them. They wrap at 65536, about 13.6 hours of
 *   continuous running at 750 ms per sample. They do reset to zero on a cold
 *   boot with no RTC retention, e.g. after the battery is disconnected, so a
 *   client should treat a large backwards jump as a restart rather than a
 *   wrap.
 *
 * ---------------------------------------------------------------------------
 * Standard services (so generic BLE apps work without knowing anything)
 * ---------------------------------------------------------------------------
 *   0x181A  Environmental Sensing
 *     0x2A6E  Temperature          read, notify   int16, 0.01 degC
 *   0x180F  Battery Service
 *     0x2A19  Battery Level        read, notify   uint8, 0..100
 *
 * ---------------------------------------------------------------------------
 * Custom service  b7e1c0a0-4f3d-4a21-9f3e-6c1a2d5b7e01
 * ---------------------------------------------------------------------------
 *
 * MEASUREMENT  ...7e02   read, notify   8 bytes, one per sample
 *     [0..1]  Sequence number, uint16
 *     [2..3]  Temperature, int16
 *     [4]     Battery percentage, uint8
 *     [5]     Press count, uint8
 *     [6]     Flags: bit0 = probe present
 *                    bit1 = button currently held
 *     [7]     Reserved, 0
 *
 *   This exists alongside 0x2A6E because it delivers the whole sample as one
 *   atomic packet. Reading temperature and battery from two characteristics
 *   cannot tell you they came from the same instant.
 *
 * PLANNED, NOT YET IMPLEMENTED
 *   CALIBRATION  ...7e06   read, write   8 bytes
 *     float scale, float offset, little endian, applied as
 *     corrected = raw * scale + offset.
 *   Calibration is an app feature in the shipping product: the app walks the
 *   user through an ice-slush and a boiling-water measurement, asks for
 *   station pressure to get the true boiling point, computes the pair and
 *   writes it here, and the Feather persists it in NVS. This MVP hard codes
 *   the pair for one specific probe instead - see the calibration block
 *   further down.
 *
 * TYPICAL CLIENT FLOW
 *   Scan for the name or 0x181A and read the beacon for a live value, or
 *   connect and subscribe to MEASUREMENT for an unbroken stream. Timestamp
 *   notifications on arrival; the device has no clock of its own.
 *
 * ---------------------------------------------------------------------------
 * EMBEDDED FONT
 * ---------------------------------------------------------------------------
 * The digits are Spleen 32x64 and Spleen 16x32, version 2.2.0. Only the
 * twelve characters this sketch needs are embedded: '0'-'9', '-' and '.'.
 *
 *   Spleen
 *   Copyright (c) 2018-2026, Frederic Cambus
 *   https://www.cambus.net/
 *   SPDX-License-Identifier: BSD-2-Clause
 *
 *   Redistribution and use in source and binary forms, with or without
 *   modification, are permitted provided that the following conditions are
 *   met:
 *
 *   1. Redistributions of source code must retain the above copyright
 *      notice, this list of conditions and the following disclaimer.
 *
 *   2. Redistributions in binary form must reproduce the above copyright
 *      notice, this list of conditions and the following disclaimer in the
 *      documentation and/or other materials provided with the distribution.
 *
 *   THIS SOFTWARE IS PROVIDED BY THE COPYRIGHT HOLDERS AND CONTRIBUTORS
 *   "AS IS" AND ANY EXPRESS OR IMPLIED WARRANTIES, INCLUDING, BUT NOT
 *   LIMITED TO, THE IMPLIED WARRANTIES OF MERCHANTABILITY AND FITNESS FOR A
 *   PARTICULAR PURPOSE ARE DISCLAIMED. IN NO EVENT SHALL THE COPYRIGHT
 *   HOLDER OR CONTRIBUTORS BE LIABLE FOR ANY DIRECT, INDIRECT, INCIDENTAL,
 *   SPECIAL, EXEMPLARY, OR CONSEQUENTIAL DAMAGES (INCLUDING, BUT NOT
 *   LIMITED TO, PROCUREMENT OF SUBSTITUTE GOODS OR SERVICES; LOSS OF USE,
 *   DATA, OR PROFITS; OR BUSINESS INTERRUPTION) HOWEVER CAUSED AND ON ANY
 *   THEORY OF LIABILITY, WHETHER IN CONTRACT, STRICT LIABILITY, OR TORT
 *   (INCLUDING NEGLIGENCE OR OTHERWISE) ARISING IN ANY WAY OUT OF THE USE
 *   OF THIS SOFTWARE, EVEN IF ADVISED OF THE POSSIBILITY OF SUCH DAMAGE.
 *
 * ---------------------------------------------------------------------------
 * LIBRARIES  (Arduino IDE / Library Manager)
 * ---------------------------------------------------------------------------
 *   esp32 board package by Espressif  (board: "Adafruit Feather ESP32-S3
 *                                      No PSRAM")
 *   Adafruit GFX Library
 *   Adafruit SH110X
 *   Adafruit MAX1704X
 *   OneWire              (Paul Stoffregen) 2.3.7 or later for ESP32 support
 *   DallasTemperature    (Miles Burton)
 *   NimBLE-Arduino       2.x REQUIRED. The callback signatures and the
 *                          advertising API below are 2.x only; 1.4.x will
 *                          not compile against this sketch.
 * ==========================================================================*/

#include <Wire.h>
#include <Adafruit_GFX.h>
#include <Adafruit_SH110X.h>
#include <Adafruit_MAX1704X.h>
#include <OneWire.h>
#include <DallasTemperature.h>
#include <NimBLEDevice.h>
#include <math.h>
#include <string.h>

#include "esp_sleep.h"
#include "esp_system.h"
#include "driver/rtc_io.h"

/* -------------------------------------------------------------------------
 * Pins
 * ---------------------------------------------------------------------- */
#define PIN_BUTTON      A0      /* GPIO18 - RTC capable, needed for EXT0 wake */
#define PIN_ONEWIRE     A1      /* GPIO17 */
#define PIN_BUTTON_LED  A2      /* GPIO16 - NPN base via 1k */

#define USE_BUTTON_LED  1       /* 0 if the LED ring driver is not fitted */

/* The Feather's switchable I2C rail powers the SDA/SCL pull-ups and the
 * STEMMA QT connector. The macro name differs between core versions. */
#if defined(PIN_I2C_POWER)
  #define I2C_PWR_PIN   PIN_I2C_POWER
#elif defined(TFT_I2C_POWER)
  #define I2C_PWR_PIN   TFT_I2C_POWER
#else
  #define I2C_PWR_PIN   7
#endif

#if defined(NEOPIXEL_POWER)
  #define NEO_PWR_PIN   NEOPIXEL_POWER
#elif defined(PIN_NEOPIXEL_POWER)
  #define NEO_PWR_PIN   PIN_NEOPIXEL_POWER
#endif

/* -------------------------------------------------------------------------
 * Tunables
 * ---------------------------------------------------------------------- */
static const uint32_t LONG_PRESS_MS    = 1200;  /* hold time to toggle power  */
static const uint32_t DEBOUNCE_MS      = 30;
/* How long the button must read released before we commit to deep sleep.
 * EXT0 is level-triggered, so a contact that re-closes after we have armed
 * it wakes the chip instantly. Must comfortably exceed release bounce. */
static const uint32_t BUTTON_SETTLE_MS = 150;
static const uint32_t BATTERY_POLL_MS  = 10000; /* fuel gauge re-read period  */

/* DS18B20 conversion time by resolution:
 *   9-bit  ~94 ms (0.5 degC)   10-bit ~188 ms (0.25 degC)
 *  11-bit ~375 ms (0.125 degC) 12-bit ~750 ms (0.0625 degC)
 * We display one decimal place, so 11-bit is enough if you want a faster
 * refresh; 12-bit is the default here for best noise behaviour. */
static const uint8_t  DS_RESOLUTION    = 12;
static const uint32_t DS_CONVERT_MS    = 750;

/* ---- Probe calibration ---------------------------------------------------
 * Two-point linear correction:  corrected = raw * CAL_SCALE + CAL_OFFSET
 *
 * The DS18B20 is factory trimmed and has no calibration registers, so this
 * corrects the residual error of one specific probe. Re-derive it if the
 * probe is ever replaced.
 *
 * MVP LIMITATION - THESE CONSTANTS ARE HARD CODED FOR ONE SENSOR.
 * In the shipping product, calibration belongs in the mobile app: the user
 * performs the ice and boiling measurements with the app prompting for
 * station pressure, the app computes scale and offset, and writes them to
 * the Feather over BLE. That needs a writable calibration characteristic on
 * the custom service (see the BLE INTERFACE block above) and the pair
 * persisted in NVS so it survives a power cycle and a firmware update. The
 * two constants below then become defaults, used only until the app has
 * written real ones. Until that exists, this build is tied to the specific
 * probe measured below and must not be shipped with a different one.
 *
 * Measured on this unit:
 *   ice slush   raw -0.2   true   0.0
 *   boiling     raw 98.7   true  99.6
 *
 * True boiling is not 100. It was 99.6 at the time of measurement: sea-level
 * pressure 1001 hPa, less ~1.8 hPa for 15 m of elevation, gives ~999 hPa
 * station pressure, and water boils at roughly 0.028 degC per hPa below the
 * 100 degC / 1013 hPa reference.
 *
 *   CAL_SCALE  = (trueBoil - trueIce) / (rawBoil - rawIce)
 *              = (99.6 - 0.0) / (98.7 - -0.2) = 99.6 / 98.9 = 1.00708
 *   CAL_OFFSET = trueIce - rawIce * CAL_SCALE
 *              = 0.0 - (-0.2 * 1.00708) = +0.201
 *
 * A single offset was not enough: the error is -0.2 at the ice point and
 * -0.9 at boiling, so it is a slope error. Offsetting by +0.2 to fix the ice
 * point alone would leave boiling reading 98.9.
 *
 * To disable, set CAL_SCALE to 1.0f and CAL_OFFSET to 0.0f.
 *
 * Repeating the calibration:
 *   1. Crushed or shaved ice with just enough water to slush, stirred, probe
 *      immersed at least 60 mm. This is the trustworthy point - it is inside
 *      the sensor's +/-0.5 degC band and does not depend on the weather.
 *   2. Boiling water, same immersion, and look up the station pressure at
 *      the time. Note the datasheet only claims +/-2 degC above 85 degC, so
 *      this end of the curve is the weaker of the two.
 * ---------------------------------------------------------------------- */
static const float    CAL_SCALE        = 1.00708f;
static const float    CAL_OFFSET       = 0.201f;

/* Tear the BLE stack down before deep sleep, or just stop it and sleep.
 * deinit() frees every service and characteristic, which is the tidy thing
 * to do but is also the most likely place for a crash on the way to sleep -
 * a notify in flight on the host task becomes a use-after-free. Deep sleep
 * powers the radio down regardless, so 0 is a safe fallback if the reset
 * reason logged at boot ever points here. */
#define BLE_DEINIT_BEFORE_SLEEP  1

#define BLE_COMPANY_ID       0xFFFF     /* SIG "internal use" - replace       */
#define BLE_DEVICE_NAME      "FTHERM"

#define UUID_SVC     "b7e1c0a0-4f3d-4a21-9f3e-6c1a2d5b7e01"
#define UUID_MEAS    "b7e1c0a0-4f3d-4a21-9f3e-6c1a2d5b7e02"

static const int16_t  TEMP_INVALID     = INT16_MIN;   /* 0x8000 sentinel      */

/* -------------------------------------------------------------------------
 * Display geometry (128x64 after setRotation(1))
 *
 * Digits are Spleen bitmaps (see the licence block at the top of the file),
 * not drawn shapes. Spleen ships fixed cells that match the spec exactly:
 * 32x64 for the integer digits and 16x32 for the tenths.
 *
 *   col:  0        32       64       96   112      128
 *         +--------+--------+--------+----+----+
 *   row 0  |        |        |        | BT | BAT |   <- status icons
 *          | 32x64  | 32x64  | 32x64  |----+----|
 *          |  cell0 |  cell1 |  cell2 | .  | 5  |
 *          |        |        |        |16x32 16x32
 *   row 63 +--------+--------+--------+----+----+
 *
 *   Three 32 px cells plus two 16 px cells is exactly 128 px, so the layout
 *   fills the width with no fudging.
 *
 *   The two 16 px cells sit at y=26, and the tallest ink in them starts at
 *   row 32, which leaves the 32x32 block at x>=96, y<32 free. The status
 *   icons live there. They are kept inside rows 0..16 so they clear the
 *   nominal cell boundary at row 26, not just the ink.
 *
 *   Integer field is right-aligned across the three big cells:
 *     "125.6" -> [1][2][5] . [6]
 *     "-15.2" -> [-][1][5] . [2]
 *     "-5.0"  -> [ ][-][5] . [0]
 *
 *   Ink inside the cells: a 32x64 digit inks rows 12..51, a 16x32 digit inks
 *   rows 6..25. Putting the small cells at y=26 lands both baselines on row
 *   51, which is what SM_Y below is for. Do not change one without the other.
 * ---------------------------------------------------------------------- */
#define SCREEN_W        128
#define SCREEN_H        64

#define BIG_W           32      /* Spleen 32x64 cell */
#define BIG_H           64
#define BIG_X0          0
#define BIG_Y           0

#define SM_W            16      /* Spleen 16x32 cell */
#define SM_H            32
#define SM_Y            26      /* aligns the small baseline with the big one */
#define DP_X            96      /* the '.' cell   */
#define SM_X            112     /* the tenths cell */

#define GLYPH_MINUS     10      /* index into the glyph tables */
#define GLYPH_DOT       11
#define GLYPH_COUNT     12

/* Status icons, top right. Bluetooth is 8x16 at x=110..117, battery is 7x13
 * at x=120..126, with a 2 px gap between them and col 127 left as margin.
 * The battery is offset down 2 px so the two icons look centred on each
 * other despite the height difference. */
#define BT_ICON_X       110
#define BT_ICON_Y       0
#define BT_ICON_W       8
#define BT_ICON_H       16

#define BATT_ICON_X     120
#define BATT_ICON_Y     2
#define BATT_ICON_W     7       /* 1 px outline, 5 px wide interior */
#define BATT_ICON_H     13      /* 1 px nub + 12 px body           */
#define BATT_ICON_LEVELS 10     /* interior is 10 px tall: one row per 10% */

/* -------------------------------------------------------------------------
 * Objects
 * ---------------------------------------------------------------------- */
Adafruit_SH1107   display(64, 128, &Wire);   /* native 64x128, rotated below */
Adafruit_MAX17048 maxlipo;
OneWire           oneWire(PIN_ONEWIRE);
DallasTemperature sensors(&oneWire);
DeviceAddress     probeAddr;

static NimBLEServer         *pServer    = nullptr;
static NimBLEAdvertising    *pAdv       = nullptr;
static NimBLECharacteristic *chrMeas    = nullptr;
static NimBLECharacteristic *chrEssTemp = nullptr;
static NimBLECharacteristic *chrBattLvl = nullptr;

/* -------------------------------------------------------------------------
 * Persisted across deep sleep so the client sees monotonic counters even
 * when the unit is switched off and on again. Zeroed on a cold boot.
 * ---------------------------------------------------------------------- */
RTC_DATA_ATTR static uint16_t rtcSeq        = 0;
RTC_DATA_ATTR static uint8_t  rtcPressCount = 0;

/* Power intent, deliberately RTC_NOINIT_ATTR rather than RTC_DATA_ATTR.
 *
 * RTC_DATA_ATTR is re-initialised by the startup code on a software or
 * watchdog reset; RTC_NOINIT_ATTR survives every reset except power-on. That
 * difference is the entire point here - we need to still know we were
 * shutting down even if the shutdown itself crashed. Without it, any reset
 * during teardown falls through to the power-on path and the unit appears to
 * switch straight back on.
 *
 * NOINIT means the contents are undefined at power-on, hence the magic
 * value: if it does not match, this is a cold boot and the state word is
 * garbage. */
#define PWR_MAGIC       0x54484D31UL   /* 'THM1' */
#define PWR_STATE_ON    0xA5A5A5A5UL
#define PWR_STATE_OFF   0x5A5A5A5AUL

RTC_NOINIT_ATTR static uint32_t rtcPwrMagic;
RTC_NOINIT_ATTR static uint32_t rtcPwrState;

/* ---- Boot log -----------------------------------------------------------
 * Deep sleep powers the USB peripheral down, so the host closes the port and
 * anything printed early in setup() after a wake goes nowhere: the monitor
 * has not re-enumerated and reopened the port yet. Printing live is simply
 * not possible over native USB across a sleep cycle.
 *
 * So each boot appends a record here instead, in RTC memory that survives
 * both deep sleep and a crash, and the whole history is dumped the moment
 * the serial monitor actually attaches. The record for a failed shutdown
 * therefore appears on the FOLLOWING boot - switch off, switch on, wait for
 * the monitor, read the log.
 *
 * For live output across sleep, use a UART instead: a USB-serial adapter on
 * TX (GPIO39) and RX (GPIO38) keeps the port open because it belongs to the
 * adapter, not to the ESP32. Print to Serial0 rather than Serial in that
 * case.
 * ---------------------------------------------------------------------- */
#define DEBUG_BOOT_LOG   1
#define BOOT_LOG_COUNT   8

typedef struct __attribute__((packed)) {
  uint8_t seq;      /* boot counter, wraps at 256                        */
  uint8_t reset;    /* esp_reset_reason()                                */
  uint8_t wake;     /* esp_sleep_get_wakeup_cause()                      */
  uint8_t prior;    /* 0 = cold boot, 1 = was ON, 2 = was shutting down  */
} BootRecord;

RTC_NOINIT_ATTR static BootRecord rtcBootLog[BOOT_LOG_COUNT];
RTC_NOINIT_ATTR static uint8_t    rtcBootSeq;

/* -------------------------------------------------------------------------
 * State
 * ---------------------------------------------------------------------- */
static bool     haveDisplay   = false;
static bool     haveGauge     = false;
static bool     haveProbe     = false;
static bool     bleUp         = false;

static float    tempC         = NAN;
static bool     tempValid     = false;
static uint32_t convStartedAt = 0;
static bool     convPending   = false;

static uint8_t  batteryPct    = 0;
static uint32_t lastBatteryAt = 0;

static int32_t  drawnKey       = INT32_MIN;  /* what is currently on screen  */
static bool     drawnConnected = false;
static uint8_t  drawnBattRows  = 0xFF;      /* forces a first paint          */

static volatile bool     bleConnected  = false;
static volatile uint16_t bleConnHandle = 0;

/* Debounced button tracker --------------------------------------------- */
struct ButtonState {
  bool     pressed     = false;   /* debounced */
  bool     lastRaw     = false;
  uint32_t lastChange  = 0;
  uint32_t pressStart  = 0;
  bool     longFired   = false;
  bool     eatRelease  = false;
} btn;

enum ButtonEvent { BTN_NONE = 0, BTN_SHORT = 1, BTN_LONG = 2 };

#if DEBUG_BOOT_LOG
static const char *resetName(uint8_t r) {
  switch (r) {
    case ESP_RST_POWERON:   return "POWERON";
    case ESP_RST_EXT:       return "EXT_PIN";
    case ESP_RST_SW:        return "SW_RESTART";
    case ESP_RST_PANIC:     return "PANIC";
    case ESP_RST_INT_WDT:   return "INT_WDT";
    case ESP_RST_TASK_WDT:  return "TASK_WDT";
    case ESP_RST_WDT:       return "OTHER_WDT";
    case ESP_RST_DEEPSLEEP: return "DEEPSLEEP";
    case ESP_RST_BROWNOUT:  return "BROWNOUT";
    default:                return "UNKNOWN";
  }
}

static const char *wakeName(uint8_t w) {
  switch (w) {
    case ESP_SLEEP_WAKEUP_EXT0:  return "EXT0";
    case ESP_SLEEP_WAKEUP_TIMER: return "TIMER";
    case ESP_SLEEP_WAKEUP_UNDEFINED: return "-";
    default:                     return "other";
  }
}

static const char *priorName(uint8_t p) {
  return (p == 0) ? "cold" : (p == 1 ? "was ON" : "was OFF");
}

static void bootLogAppend(uint8_t reset, uint8_t wake, uint8_t prior) {
  BootRecord *r = &rtcBootLog[rtcBootSeq % BOOT_LOG_COUNT];
  r->seq   = rtcBootSeq;
  r->reset = reset;
  r->wake  = wake;
  r->prior = prior;
  rtcBootSeq++;
}

/* Oldest first. A DEEPSLEEP reset with prior "was OFF" is a clean off/on
 * cycle. A PANIC, watchdog or BROWNOUT with prior "was OFF" means the
 * shutdown crashed rather than slept, and the fail-safe caught it - look at
 * BLE_DEINIT_BEFORE_SLEEP first. */
static void bootLogDump() {
  Serial.println("---- boot log, oldest first ----");
  const uint8_t n = (rtcBootSeq < BOOT_LOG_COUNT) ? rtcBootSeq : BOOT_LOG_COUNT;
  for (uint8_t i = 0; i < n; i++) {
    const uint8_t     idx = (uint8_t)((rtcBootSeq - n + i) % BOOT_LOG_COUNT);
    const BootRecord *r   = &rtcBootLog[idx];
    Serial.printf("  #%-3u reset=%-10s wake=%-5s prior=%s\n",
                  r->seq, resetName(r->reset), wakeName(r->wake),
                  priorName(r->prior));
  }
  Serial.println("--------------------------------");
}
#endif /* DEBUG_BOOT_LOG */

/* Forward declarations */
static void goToSleep();

/* =========================================================================
 * Spleen glyph tables
 *
 * Twelve characters at each size: '0'..'9' at indices 0..9, '-' at 10, '.'
 * at 11. Extracted verbatim from the Spleen BDF files, no reflowing: BDF
 * pads each row to a byte boundary, MSB first, which is precisely the
 * layout Adafruit_GFX::drawBitmap() expects. 32x64 is 4 bytes x 64 rows =
 * 256 bytes per glyph; 16x32 is 2 bytes x 32 rows = 64 bytes. 3840 bytes
 * of flash for the set.
 *
 * drawBitmap only sets the ink pixels and leaves the rest alone, so every
 * screen clears first.
 * ====================================================================== */
static const uint8_t GLYPH32[GLYPH_COUNT][256] PROGMEM = {
  { /* '0' */
    0x00, 0x00, 0x00, 0x00, 0x00, 0x00, 0x00, 0x00,
    0x00, 0x00, 0x00, 0x00, 0x00, 0x00, 0x00, 0x00,
    0x00, 0x00, 0x00, 0x00, 0x00, 0x00, 0x00, 0x00,
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    0x00, 0x00, 0x00, 0x00, 0x00, 0x00, 0x00, 0x00,
  },
  { /* '1' */
    0x00, 0x00, 0x00, 0x00, 0x00, 0x00, 0x00, 0x00,
    0x00, 0x00, 0x00, 0x00, 0x00, 0x00, 0x00, 0x00,
    0x00, 0x00, 0x00, 0x00, 0x00, 0x00, 0x00, 0x00,
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    0x00, 0x00, 0x00, 0x00, 0x00, 0x00, 0x00, 0x00,
  },
  { /* '2' */
    0x00, 0x00, 0x00, 0x00, 0x00, 0x00, 0x00, 0x00,
    0x00, 0x00, 0x00, 0x00, 0x00, 0x00, 0x00, 0x00,
    0x00, 0x00, 0x00, 0x00, 0x00, 0x00, 0x00, 0x00,
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    0x00, 0x00, 0x00, 0x00, 0x00, 0x00, 0x00, 0x00,
  },
  { /* '3' */
    0x00, 0x00, 0x00, 0x00, 0x00, 0x00, 0x00, 0x00,
    0x00, 0x00, 0x00, 0x00, 0x00, 0x00, 0x00, 0x00,
    0x00, 0x00, 0x00, 0x00, 0x00, 0x00, 0x00, 0x00,
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    0x00, 0x00, 0x00, 0x00, 0x00, 0x00, 0x00, 0x00,
  },
  { /* '4' */
    0x00, 0x00, 0x00, 0x00, 0x00, 0x00, 0x00, 0x00,
    0x00, 0x00, 0x00, 0x00, 0x00, 0x00, 0x00, 0x00,
    0x00, 0x00, 0x00, 0x00, 0x00, 0x00, 0x00, 0x00,
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    0x00, 0x00, 0x00, 0x00, 0x00, 0x00, 0x00, 0x00,
  },
  { /* '5' */
    0x00, 0x00, 0x00, 0x00, 0x00, 0x00, 0x00, 0x00,
    0x00, 0x00, 0x00, 0x00, 0x00, 0x00, 0x00, 0x00,
    0x00, 0x00, 0x00, 0x00, 0x00, 0x00, 0x00, 0x00,
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    0x00, 0x00, 0x00, 0x00, 0x00, 0x00, 0x00, 0x00,
  },
  { /* '6' */
    0x00, 0x00, 0x00, 0x00, 0x00, 0x00, 0x00, 0x00,
    0x00, 0x00, 0x00, 0x00, 0x00, 0x00, 0x00, 0x00,
    0x00, 0x00, 0x00, 0x00, 0x00, 0x00, 0x00, 0x00,
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    0x00, 0x00, 0x00, 0x00, 0x00, 0x00, 0x00, 0x00,
  },
  { /* '7' */
    0x00, 0x00, 0x00, 0x00, 0x00, 0x00, 0x00, 0x00,
    0x00, 0x00, 0x00, 0x00, 0x00, 0x00, 0x00, 0x00,
    0x00, 0x00, 0x00, 0x00, 0x00, 0x00, 0x00, 0x00,
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    0x00, 0x00, 0x00, 0x00, 0x00, 0x00, 0x00, 0x00,
  },
  { /* '8' */
    0x00, 0x00, 0x00, 0x00, 0x00, 0x00, 0x00, 0x00,
    0x00, 0x00, 0x00, 0x00, 0x00, 0x00, 0x00, 0x00,
    0x00, 0x00, 0x00, 0x00, 0x00, 0x00, 0x00, 0x00,
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    0x00, 0x00, 0x00, 0x00, 0x00, 0x00, 0x00, 0x00,
  },
  { /* '9' */
    0x00, 0x00, 0x00, 0x00, 0x00, 0x00, 0x00, 0x00,
    0x00, 0x00, 0x00, 0x00, 0x00, 0x00, 0x00, 0x00,
    0x00, 0x00, 0x00, 0x00, 0x00, 0x00, 0x00, 0x00,
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    0x00, 0x00, 0x00, 0x00, 0x00, 0x00, 0x00, 0x00,
  },
  { /* '-' */
    0x00, 0x00, 0x00, 0x00, 0x00, 0x00, 0x00, 0x00,
    0x00, 0x00, 0x00, 0x00, 0x00, 0x00, 0x00, 0x00,
    0x00, 0x00, 0x00, 0x00, 0x00, 0x00, 0x00, 0x00,
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    0x00, 0x00, 0x00, 0x00, 0x00, 0x00, 0x00, 0x00,
  },
  { /* '.' */
    0x00, 0x00, 0x00, 0x00, 0x00, 0x00, 0x00, 0x00,
    0x00, 0x00, 0x00, 0x00, 0x00, 0x00, 0x00, 0x00,
    0x00, 0x00, 0x00, 0x00, 0x00, 0x00, 0x00, 0x00,
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    0x00, 0x00, 0x00, 0x00, 0x00, 0x00, 0x00, 0x00,
  },
};

static const uint8_t GLYPH16[GLYPH_COUNT][64] PROGMEM = {
  { /* '0' */
    0x00, 0x00, 0x00, 0x00, 0x00, 0x00, 0x00, 0x00,
    0x00, 0x00, 0x00, 0x00, 0x0F, 0xF0, 0x1F, 0xF8,
    0x38, 0x1C, 0x30, 0x0C, 0x30, 0x0C, 0x30, 0x1C,
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    0x00, 0x00, 0x00, 0x00, 0x00, 0x00, 0x00, 0x00,
  },
  { /* '1' */
    0x00, 0x00, 0x00, 0x00, 0x00, 0x00, 0x00, 0x00,
    0x00, 0x00, 0x00, 0x00, 0x03, 0x80, 0x07, 0x80,
    0x0D, 0x80, 0x19, 0x80, 0x11, 0x80, 0x01, 0x80,
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    0x00, 0x00, 0x00, 0x00, 0x00, 0x00, 0x00, 0x00,
  },
  { /* '2' */
    0x00, 0x00, 0x00, 0x00, 0x00, 0x00, 0x00, 0x00,
    0x00, 0x00, 0x00, 0x00, 0x0F, 0xF0, 0x1F, 0xF8,
    0x38, 0x1C, 0x30, 0x0C, 0x00, 0x0C, 0x00, 0x0C,
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    0x00, 0x00, 0x00, 0x00, 0x00, 0x00, 0x00, 0x00,
  },
  { /* '3' */
    0x00, 0x00, 0x00, 0x00, 0x00, 0x00, 0x00, 0x00,
    0x00, 0x00, 0x00, 0x00, 0x0F, 0xF0, 0x1F, 0xF8,
    0x38, 0x1C, 0x30, 0x0C, 0x00, 0x0C, 0x00, 0x0C,
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    0x00, 0x00, 0x00, 0x00, 0x00, 0x00, 0x00, 0x00,
  },
  { /* '4' */
    0x00, 0x00, 0x00, 0x00, 0x00, 0x00, 0x00, 0x00,
    0x00, 0x00, 0x00, 0x00, 0x30, 0x00, 0x30, 0x00,
    0x30, 0x00, 0x30, 0x00, 0x30, 0x30, 0x30, 0x30,
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    0x00, 0x00, 0x00, 0x00, 0x00, 0x00, 0x00, 0x00,
  },
  { /* '5' */
    0x00, 0x00, 0x00, 0x00, 0x00, 0x00, 0x00, 0x00,
    0x00, 0x00, 0x00, 0x00, 0x3F, 0xFC, 0x3F, 0xFC,
    0x30, 0x0C, 0x30, 0x0C, 0x30, 0x00, 0x30, 0x00,
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    0x00, 0x00, 0x00, 0x00, 0x00, 0x00, 0x00, 0x00,
  },
  { /* '6' */
    0x00, 0x00, 0x00, 0x00, 0x00, 0x00, 0x00, 0x00,
    0x00, 0x00, 0x00, 0x00, 0x0F, 0xF0, 0x1F, 0xF8,
    0x38, 0x1C, 0x30, 0x0C, 0x30, 0x00, 0x30, 0x00,
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    0x00, 0x00, 0x00, 0x00, 0x00, 0x00, 0x00, 0x00,
  },
  { /* '7' */
    0x00, 0x00, 0x00, 0x00, 0x00, 0x00, 0x00, 0x00,
    0x00, 0x00, 0x00, 0x00, 0x3F, 0xFC, 0x3F, 0xFC,
    0x30, 0x0C, 0x30, 0x0C, 0x00, 0x0C, 0x00, 0x0C,
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    0x00, 0x00, 0x00, 0x00, 0x00, 0x00, 0x00, 0x00,
  },
  { /* '8' */
    0x00, 0x00, 0x00, 0x00, 0x00, 0x00, 0x00, 0x00,
    0x00, 0x00, 0x00, 0x00, 0x0F, 0xF0, 0x1F, 0xF8,
    0x38, 0x1C, 0x30, 0x0C, 0x30, 0x0C, 0x30, 0x0C,
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    0x00, 0x00, 0x00, 0x00, 0x00, 0x00, 0x00, 0x00,
  },
  { /* '9' */
    0x00, 0x00, 0x00, 0x00, 0x00, 0x00, 0x00, 0x00,
    0x00, 0x00, 0x00, 0x00, 0x0F, 0xF0, 0x1F, 0xF8,
    0x38, 0x1C, 0x30, 0x0C, 0x30, 0x0C, 0x30, 0x0C,
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    0x00, 0x00, 0x00, 0x00, 0x00, 0x00, 0x00, 0x00,
  },
  { /* '-' */
    0x00, 0x00, 0x00, 0x00, 0x00, 0x00, 0x00, 0x00,
    0x00, 0x00, 0x00, 0x00, 0x00, 0x00, 0x00, 0x00,
    0x00, 0x00, 0x00, 0x00, 0x00, 0x00, 0x00, 0x00,
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    0x00, 0x00, 0x00, 0x00, 0x00, 0x00, 0x00, 0x00,
  },
  { /* '.' */
    0x00, 0x00, 0x00, 0x00, 0x00, 0x00, 0x00, 0x00,
    0x00, 0x00, 0x00, 0x00, 0x00, 0x00, 0x00, 0x00,
    0x00, 0x00, 0x00, 0x00, 0x00, 0x00, 0x00, 0x00,
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    0x00, 0x00, 0x00, 0x00, 0x00, 0x00, 0x00, 0x00,
  },
};

static void drawBig(int16_t x, int16_t y, uint8_t idx) {
  if (idx >= GLYPH_COUNT) return;
  display.drawBitmap(x, y, GLYPH32[idx], BIG_W, BIG_H, SH110X_WHITE);
}

static void drawSmall(int16_t x, int16_t y, uint8_t idx) {
  if (idx >= GLYPH_COUNT) return;
  display.drawBitmap(x, y, GLYPH16[idx], SM_W, SM_H, SH110X_WHITE);
}

/* =========================================================================
 * Screens
 * ====================================================================== */

/* Bluetooth rune, 8x16, MSB = leftmost pixel. Built from strokes rather than
 * traced by eye: a full-height stem at column 3, two flags on the right
 * (stem top -> col 6 -> back), and the two 45-degree diagonals that run past
 * the stem and cross each other at column 1-2.
 *
 *     ...#....  ...##...  ...#.#..  ...#..#.  ...#.#..  ...##...
 *     #..#....  .###....  .###....  #..#....  ...##...  ...#.#..
 *     ...#..#.  ...#.#..  ...##...  ...#....
 */
static const uint8_t BT_ICON[BT_ICON_H] PROGMEM = {
  0x10, 0x18, 0x14, 0x12, 0x14, 0x18, 0x90, 0x70,
  0x70, 0x90, 0x18, 0x14, 0x12, 0x14, 0x18, 0x10
};

static void drawBluetoothIcon(int16_t x, int16_t y) {
  display.drawBitmap(x, y, BT_ICON, BT_ICON_W, BT_ICON_H, SH110X_WHITE);
}

/* How many of the ten interior rows to fill. Rounds to nearest, so 0-4% is
 * empty and 95-100% is full. */
static uint8_t battFillRows(uint8_t pct) {
  if (pct > 100) pct = 100;
  uint8_t n = (uint8_t)((pct + 5) / 10);
  return (n > BATT_ICON_LEVELS) ? BATT_ICON_LEVELS : n;
}

/* Battery icon: 3 px terminal nub on the top row, then a 7x12 single-pixel
 * outline enclosing a 5x10 interior, filled from the bottom up. Drawn with
 * primitives rather than eleven bitmaps because the fill is the only part
 * that changes. */
static void drawBatteryIcon(int16_t x, int16_t y, uint8_t pct) {
  display.drawFastHLine(x + 2, y, 3, SH110X_WHITE);          /* nub      */
  display.drawRect(x, y + 1, BATT_ICON_W, 12, SH110X_WHITE); /* outline  */

  const uint8_t n = battFillRows(pct);
  if (n > 0) {
    /* Interior spans rows y+2 .. y+11; the fill is bottom-aligned in it. */
    display.fillRect(x + 1, y + 12 - n, 5, n, SH110X_WHITE);
  }
}

static void drawStatusIcons(bool connected, uint8_t pct) {
  if (connected) drawBluetoothIcon(BT_ICON_X, BT_ICON_Y);
  drawBatteryIcon(BATT_ICON_X, BATT_ICON_Y, pct);
}

/* Render the whole screen: temperature plus the status icons. Cells are
 * filled right-to-left so the value is right-aligned against the decimal
 * point. */
static void drawMainScreen(bool valid, int16_t tenths, bool connected,
                           uint8_t pct) {
  if (!haveDisplay) return;
  display.clearDisplay();
  drawStatusIcons(connected, pct);

  if (!valid) {
    /* No reading yet, or the probe has gone away: leave the digit area
     * blank. The battery icon already shows the unit is powered. */
    display.display();
    return;
  }

  const bool    negative = (tenths < 0);
  const int32_t mag      = negative ? -(int32_t)tenths : (int32_t)tenths;
  int32_t       whole    = mag / 10;
  const uint8_t frac     = (uint8_t)(mag % 10);

  /* Clamp to what the three-cell field can show. */
  if (negative && whole > 99)   whole = 99;
  if (!negative && whole > 999) whole = 999;

  /* Build the integer cells, right-aligned. -1 means "blank". */
  int8_t  cell[3] = { -1, -1, -1 };
  int8_t  idx     = 2;
  int32_t v       = whole;
  do {
    cell[idx--] = (int8_t)(v % 10);
    v /= 10;
  } while (v > 0 && idx >= 0);

  if (negative && idx >= 0) {
    cell[idx] = (int8_t)GLYPH_MINUS;
  }

  for (uint8_t i = 0; i < 3; i++) {
    if (cell[i] >= 0) drawBig(BIG_X0 + i * BIG_W, BIG_Y, (uint8_t)cell[i]);
  }

  drawSmall(DP_X, SM_Y, GLYPH_DOT);
  drawSmall(SM_X, SM_Y, frac);

  display.display();
}

static void displayOff() {
  if (!haveDisplay) return;
  display.clearDisplay();
  display.display();
  display.oled_command(SH110X_DISPLAYOFF);   /* 0xAE - stops the OLED bias */
}

/* =========================================================================
 * Battery
 * ====================================================================== */
static uint8_t readBatteryPercent() {
  if (!haveGauge) return 0;
  float p = maxlipo.cellPercent();
  if (isnan(p) || p < 0.0f) p = 0.0f;
  if (p > 100.0f)           p = 100.0f;      /* the MAX17048 can report >100 */
  return (uint8_t)lroundf(p);
}

/* =========================================================================
 * Encoding helpers
 * ====================================================================== */
static int16_t currentTempCenti() {
  if (!tempValid) return TEMP_INVALID;
  float scaled = tempC * 100.0f;
  if (scaled >  32767.0f) scaled =  32767.0f;
  if (scaled < -32767.0f) scaled = -32767.0f;
  return (int16_t)lroundf(scaled);
}

static void putU16(uint8_t *p, uint16_t v) {
  p[0] = (uint8_t)(v & 0xFF);
  p[1] = (uint8_t)(v >> 8);
}

static void buildManufacturerData(uint8_t *out) {
  putU16(&out[0], BLE_COMPANY_ID);
  putU16(&out[2], rtcSeq);
  putU16(&out[4], (uint16_t)currentTempCenti());
  out[6] = batteryPct;
  out[7] = rtcPressCount;
}

static void buildMeasurement(uint8_t *out) {
  putU16(&out[0], rtcSeq);
  putU16(&out[2], (uint16_t)currentTempCenti());
  out[4] = batteryPct;
  out[5] = rtcPressCount;
  out[6] = (uint8_t)((haveProbe ? 0x01 : 0x00) | (btn.pressed ? 0x02 : 0x00));
  out[7] = 0;
}

/* =========================================================================
 * BLE
 * ====================================================================== */
class ServerCallbacks : public NimBLEServerCallbacks {
  void onConnect(NimBLEServer *srv, NimBLEConnInfo &info) override {
    bleConnected  = true;
    bleConnHandle = info.getConnHandle();
    /* Ask for a relaxed interval: this is a 1.3 Hz sensor, there is nothing
     * to gain from a 15 ms connection interval. Units are 1.25 ms, so
     * 24..40 is 30..50 ms; latency 4 lets the peripheral skip events. */
    srv->updateConnParams(info.getConnHandle(), 24, 40, 4, 400);
  }

  void onDisconnect(NimBLEServer *srv, NimBLEConnInfo &info, int reason) override {
    (void)srv; (void)info; (void)reason;
    bleConnected = false;
    NimBLEDevice::startAdvertising();
  }
};

static void bleBegin() {
  NimBLEDevice::init(BLE_DEVICE_NAME);

  pServer = NimBLEDevice::createServer();
  pServer->setCallbacks(new ServerCallbacks());

  /* --- Environmental Sensing: works with off-the-shelf BLE apps --- */
  NimBLEService *ess = pServer->createService("181A");
  chrEssTemp = ess->createCharacteristic(
      "2A6E", NIMBLE_PROPERTY::READ | NIMBLE_PROPERTY::NOTIFY);
  ess->start();

  /* --- Battery Service --- */
  NimBLEService *bas = pServer->createService("180F");
  chrBattLvl = bas->createCharacteristic(
      "2A19", NIMBLE_PROPERTY::READ | NIMBLE_PROPERTY::NOTIFY);
  bas->start();

  /* --- Custom service: the whole sample in one packet --- */
  NimBLEService *svc = pServer->createService(UUID_SVC);
  chrMeas = svc->createCharacteristic(
      UUID_MEAS, NIMBLE_PROPERTY::READ | NIMBLE_PROPERTY::NOTIFY);
  svc->start();

  /* Seed the values so a read before the first sample returns something
   * well-formed rather than an empty attribute. */
  uint8_t meas[8];
  buildMeasurement(meas);
  chrMeas->setValue(meas, sizeof(meas));

  int16_t tc = currentTempCenti();
  chrEssTemp->setValue((uint8_t *)&tc, sizeof(tc));
  chrBattLvl->setValue(&batteryPct, 1);

  /* --- Advertising --- */
  uint8_t mfg[8];
  buildManufacturerData(mfg);

  pAdv = NimBLEDevice::getAdvertising();
  pAdv->setConnectableMode(BLE_GAP_CONN_MODE_UND);
  pAdv->setName(BLE_DEVICE_NAME);
  pAdv->addServiceUUID(NimBLEUUID((uint16_t)0x181A));
  pAdv->setManufacturerData(mfg, sizeof(mfg));

  /* Units of 0.625 ms: 160 = 100 ms, 240 = 150 ms. */
  pAdv->setMinInterval(160);
  pAdv->setMaxInterval(240);

  pAdv->start();
  bleUp = true;
}

/* Refresh the beacon payload. Only meaningful while advertising, which is
 * to say while nothing is connected. */
static void bleRefreshBeacon() {
  if (!bleUp || pAdv == nullptr || bleConnected) return;
  uint8_t mfg[8];
  buildManufacturerData(mfg);
  pAdv->setManufacturerData(mfg, sizeof(mfg));
  pAdv->refreshAdvertisingData();
}

static void bleEnd() {
  if (!bleUp) return;

  /* Clear the flag first so nothing can publish into a stack that is being
   * dismantled. */
  bleUp = false;

  if (pAdv != nullptr) pAdv->stop();

  if (bleConnected && pServer != nullptr) {
    pServer->disconnect(bleConnHandle);   /* clean close, not a timeout */
    /* Let the disconnect actually go out and the callback run before any
     * attribute is freed underneath the host task. */
    for (uint8_t i = 0; i < 20 && bleConnected; i++) delay(10);
  }

#if BLE_DEINIT_BEFORE_SLEEP
  NimBLEDevice::deinit(true);
#endif

  pServer    = nullptr;
  pAdv       = nullptr;
  chrMeas    = nullptr;
  chrEssTemp = nullptr;
  chrBattLvl = nullptr;
}

/* Push the current sample out. Called once per completed conversion, and
 * again on a button press so the press count does not wait for the next
 * sample. */
static void publishSample() {
  if (!bleUp) return;

  uint8_t meas[8];
  buildMeasurement(meas);
  chrMeas->setValue(meas, sizeof(meas));

  int16_t tc = currentTempCenti();
  chrEssTemp->setValue((uint8_t *)&tc, sizeof(tc));
  chrBattLvl->setValue(&batteryPct, 1);

  if (bleConnected) {
    chrMeas->notify();
    chrEssTemp->notify();
    chrBattLvl->notify();
  } else {
    bleRefreshBeacon();
  }
}

/* =========================================================================
 * Button
 * ====================================================================== */
static ButtonEvent pollButton() {
  const bool     raw = (digitalRead(PIN_BUTTON) == LOW);
  const uint32_t now = millis();

  if (raw != btn.lastRaw) {
    btn.lastRaw    = raw;
    btn.lastChange = now;
  }

  if ((now - btn.lastChange) >= DEBOUNCE_MS && raw != btn.pressed) {
    btn.pressed = raw;
    if (raw) {
      btn.pressStart = now;
      btn.longFired  = false;
    } else {
      if (btn.eatRelease) {
        btn.eatRelease = false;          /* release of the power-on hold */
      } else if (!btn.longFired) {
        return BTN_SHORT;
      }
    }
  }

  if (btn.pressed && !btn.longFired && (now - btn.pressStart) >= LONG_PRESS_MS) {
    btn.longFired = true;
    return BTN_LONG;
  }
  return BTN_NONE;
}

/* =========================================================================
 * Power
 * ====================================================================== */
static void setButtonLed(bool on) {
#if USE_BUTTON_LED
  digitalWrite(PIN_BUTTON_LED, on ? HIGH : LOW);
#else
  (void)on;
#endif
}

/* Block until the button has read released continuously for
 * BUTTON_SETTLE_MS. Any LOW sample restarts the window, so release bounce
 * cannot satisfy it the way a single digitalRead() could. No timeout: if the
 * button is stuck down, waiting here is correct - arming a level-triggered
 * wake against a closed contact just wakes the chip straight back up. */
static void waitButtonSettled() {
  uint32_t since = millis();
  while ((millis() - since) < BUTTON_SETTLE_MS) {
    if (digitalRead(PIN_BUTTON) == LOW) since = millis();
    delay(5);
  }
}

static void goToSleep() {
  /* Record the intent before anything else. If the teardown below crashes,
   * the next boot reads this, sees that we meant to switch off, and goes
   * back to sleep instead of powering up. */
  rtcPwrMagic = PWR_MAGIC;
  rtcPwrState = PWR_STATE_OFF;

  /* Blank the screen first. At a long press this happens the moment the
   * threshold is reached, which is the user's cue to let go, rather than
   * after BLE teardown. */
  displayOff();
  setButtonLed(false);
  bleEnd();

  /* Shed everything the deep-sleep domain does not need. */
#if USE_BUTTON_LED
  pinMode(PIN_BUTTON_LED, INPUT);
#endif
#ifdef NEO_PWR_PIN
  pinMode(NEO_PWR_PIN, OUTPUT);
  digitalWrite(NEO_PWR_PIN, LOW);
#endif
  pinMode(I2C_PWR_PIN, OUTPUT);
  digitalWrite(I2C_PWR_PIN, LOW);       /* kills the QT rail and I2C pull-ups */

  waitButtonSettled();

  /* rtc_gpio_init() switches the pad from the digital GPIO peripheral to the
   * RTC domain. Without it the RTC pull-up below can be ignored, leaving the
   * pin floating through deep sleep - and a floating wake pin drifts low and
   * wakes the chip for no reason. */
  rtc_gpio_init((gpio_num_t)PIN_BUTTON);
  rtc_gpio_set_direction((gpio_num_t)PIN_BUTTON, RTC_GPIO_MODE_INPUT_ONLY);
  rtc_gpio_pulldown_dis((gpio_num_t)PIN_BUTTON);
  rtc_gpio_pullup_en((gpio_num_t)PIN_BUTTON);

  esp_sleep_enable_ext0_wakeup((gpio_num_t)PIN_BUTTON, 0);

  esp_deep_sleep_start();
  /* Never returns; the next boot starts at setup(). */
}

/* Block until the button has been held for 'ms', or return false as soon as
 * it is genuinely released.
 *
 * The mirror image of waitButtonSettled(), and it needs the same care: a
 * single raw digitalRead() would abort a real long press on make bounce. So
 * a HIGH sample only counts as a release once it has persisted for
 * DEBOUNCE_MS, and a brief bounce neither aborts the hold nor restarts its
 * timer. */
static bool buttonHeldFor(uint32_t ms) {
  const uint32_t start = millis();
  bool           releasing = false;
  uint32_t       releaseAt = 0;

  while ((millis() - start) < ms) {
    if (digitalRead(PIN_BUTTON) == LOW) {
      releasing = false;
    } else if (!releasing) {
      releasing = true;
      releaseAt = millis();
    } else if ((millis() - releaseAt) >= DEBOUNCE_MS) {
      return false;
    }
    delay(5);
  }
  return true;
}

/* Seed the button tracker as already-pressed with longFired set, so the
 * release of the starting press is swallowed rather than counted as a short
 * press, and continuing to hold cannot fire a long press and switch straight
 * back off. The user has to release and press again for either to
 * register. */
static void consumeWakePress() {
  btn.pressed    = true;
  btn.lastRaw    = true;
  btn.lastChange = millis();
  btn.pressStart = millis();
  btn.longFired  = true;
  btn.eatRelease = true;
}

/* =========================================================================
 * Temperature acquisition (non-blocking)
 * ====================================================================== */
static void startConversion() {
  if (!haveProbe) return;
  sensors.requestTemperatures();      /* setWaitForConversion(false) is set */
  convStartedAt = millis();
  convPending   = true;
}

/* Returns true when a fresh reading has landed in tempC / tempValid.
 *
 * The DS18B20 guarantees the conversion is finished within DS_CONVERT_MS, so
 * a timed wait is enough - polling isConversionComplete() every few ms would
 * put pointless traffic on the bus with interrupts masked each time. */
static bool serviceConversion() {
  if (!haveProbe || !convPending) return false;
  if ((millis() - convStartedAt) < DS_CONVERT_MS) return false;

  const float c = sensors.getTempC(probeAddr);
  convPending   = false;

  /* -127 is the library's disconnected marker. 85.0 exactly is the DS18B20
   * power-on scratchpad default, i.e. a conversion that never happened. */
  if (c == DEVICE_DISCONNECTED_C || c <= -100.0f || c >= 200.0f) {
    tempValid = false;
  } else {
    /* Calibration is applied here, at the single point where a reading
     * enters the system, so the display and the BLE payload cannot
     * disagree about what the temperature is. The sanity check above
     * deliberately runs on the raw value. */
    tempC     = c * CAL_SCALE + CAL_OFFSET;
    tempValid = true;
  }

  startConversion();                  /* immediately queue the next one */
  return true;
}

/* Key used to decide whether the screen actually needs repainting. */
static int32_t temperatureKey() {
  if (!tempValid) return INT32_MIN + 1;
  return (int32_t)lroundf(tempC * 10.0f);
}

/* Repaint only when something visible actually changed. The battery is
 * compared at icon resolution, not percent, so a 71 -> 70 reading does not
 * cost a redraw. */
static void repaintIfChanged() {
  const int32_t key  = temperatureKey();
  const bool    conn = bleConnected;
  const uint8_t rows = battFillRows(batteryPct);
  if (key == drawnKey && conn == drawnConnected && rows == drawnBattRows) return;
  drawMainScreen(tempValid, (int16_t)(tempValid ? key : 0), conn, batteryPct);
  drawnKey       = key;
  drawnConnected = conn;
  drawnBattRows  = rows;
}

/* =========================================================================
 * setup / loop
 * ====================================================================== */
void setup() {
  Serial.begin(115200);

  pinMode(PIN_BUTTON, INPUT_PULLUP);
#if USE_BUTTON_LED
  pinMode(PIN_BUTTON_LED, OUTPUT);
  digitalWrite(PIN_BUTTON_LED, LOW);
#endif

  /* Boot diagnostics go into RTC memory, not out of the port. Over native
   * USB the host has not reopened the port this early after a wake, so
   * printing here would be lost. bootLogDump() runs from loop() once the
   * monitor attaches. */
  const esp_sleep_wakeup_cause_t wakeCause = esp_sleep_get_wakeup_cause();
  const bool coldBoot = (rtcPwrMagic != PWR_MAGIC);

#if DEBUG_BOOT_LOG
  if (coldBoot) {
    memset(rtcBootLog, 0, sizeof(rtcBootLog));
    rtcBootSeq = 0;
  }
  bootLogAppend((uint8_t)esp_reset_reason(), (uint8_t)wakeCause,
                coldBoot ? 0 : (rtcPwrState == PWR_STATE_OFF ? 2 : 1));
#endif

  if (wakeCause == ESP_SLEEP_WAKEUP_EXT0) {
    /* Button wake. Require the same hold as switching off, before spending
     * any power on the display, sensor or radio.
     *
     * millis() here is roughly the time since the wake edge, so subtracting
     * it makes the hold the user actually performs match LONG_PRESS_MS
     * rather than LONG_PRESS_MS plus however long boot took. */
    const uint32_t sinceWake = millis();
    const uint32_t remaining =
        (sinceWake >= LONG_PRESS_MS) ? 0 : (LONG_PRESS_MS - sinceWake);
    if (!buttonHeldFor(remaining)) {
      goToSleep();                              /* does not return */
    }
    consumeWakePress();
  } else if (!coldBoot && rtcPwrState == PWR_STATE_OFF) {
    /* Not a button wake, and the last thing we did was decide to switch off.
     * So this is a spurious reset - a crash on the way to sleep, a watchdog,
     * a brownout - and it must NOT be treated as a request to power on.
     * Straight back to sleep. Almost nothing is initialised at this point,
     * so this second attempt has very little left to trip over. The record
     * appended above is what tells you afterwards that this happened. */
    goToSleep();                                /* does not return */
  }
  /* Otherwise: cold boot, USB plug or the reset button while on. Power up,
   * which keeps development sane. */

  rtcPwrMagic = PWR_MAGIC;
  rtcPwrState = PWR_STATE_ON;

  /* Bring up the switchable I2C rail before touching the bus. */
  pinMode(I2C_PWR_PIN, OUTPUT);
  digitalWrite(I2C_PWR_PIN, HIGH);
  delay(50);

  Wire.begin();

  delay(250);                                   /* let the OLED come up */
  haveDisplay = display.begin(0x3C, true);
  if (haveDisplay) {
    display.setRotation(1);                     /* -> 128 wide x 64 tall */
    display.clearDisplay();
    display.display();
  } else {
    Serial.println(F("SH1107 not found"));
  }

  haveGauge = maxlipo.begin(&Wire);
  if (!haveGauge) Serial.println(F("MAX17048 not found"));

  sensors.begin();
  haveProbe = (sensors.getDeviceCount() > 0) && sensors.getAddress(probeAddr, 0);
  if (haveProbe) {
    sensors.setResolution(probeAddr, DS_RESOLUTION);
    sensors.setWaitForConversion(false);
    startConversion();
  } else {
    Serial.println(F("DS18B20 not found - check the 4.7k pull-up"));
  }

  setButtonLed(true);

  delay(100);                                   /* fuel gauge settling */
  batteryPct    = readBatteryPercent();
  lastBatteryAt = millis();

  bleBegin();

  /* Paint immediately. The first conversion is still ~750 ms away, so this
   * shows dashes plus the battery icon until it lands. */
  repaintIfChanged();
}

void loop() {
  const uint32_t now = millis();

#if DEBUG_BOOT_LOG
  /* Serial's bool operator tracks whether the host has the CDC port open, so
   * this fires whenever the monitor attaches - however long that takes after
   * a wake, and immediately if it was already open. */
  static bool bootLogShown = false;
  if (!bootLogShown && Serial) {
    bootLogShown = true;
    bootLogDump();
  }
#endif

  /* ---- button ---- */
  switch (pollButton()) {
    case BTN_LONG:
      goToSleep();                              /* does not return */
      break;

    case BTN_SHORT:
      rtcPressCount++;                          /* wraps at 256, by design */
      publishSample();                          /* do not make the client wait */
      break;

    default:
      break;
  }

  /* ---- temperature ---- */
  if (serviceConversion()) {
    rtcSeq++;
    repaintIfChanged();
    publishSample();
  }

  /* ---- battery ---- */
  if ((now - lastBatteryAt) >= BATTERY_POLL_MS) {
    lastBatteryAt = now;
    const uint8_t p = readBatteryPercent();
    if (p != batteryPct) {
      batteryPct = p;                           /* icon redraws via repaint */
      if (bleUp && bleConnected && chrBattLvl != nullptr) {
        chrBattLvl->setValue(&batteryPct, 1);
        chrBattLvl->notify();
      } else {
        bleRefreshBeacon();
      }
    }
  }

  /* ---- connection state on the display ---- */
  repaintIfChanged();

  delay(5);
}
